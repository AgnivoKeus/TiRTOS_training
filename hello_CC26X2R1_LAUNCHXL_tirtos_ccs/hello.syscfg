/**
 * @cliArgs --board "/ti/boards/CC26X2R1_LAUNCHXL" --product "simplelink_cc13x2_26x2_sdk@5.10.00.48"
 * @versions {"data":"2021031521","timestamp":"2021031521","tool":"1.8.0+1863","templates":null}
 */

/**
 * Import the modules used in this configuration.
 */
const Power   = scripting.addModule("/ti/drivers/Power");
const RTOS    = scripting.addModule("/ti/drivers/RTOS");
const UART    = scripting.addModule("/ti/drivers/UART", {}, false);
const UART1   = UART.addInstance();
const Button  = scripting.addModule("/ti/drivers/apps/Button", {}, false);
const Button1 = Button.addInstance();
const LED     = scripting.addModule("/ti/drivers/apps/LED", {}, false);
const LED1    = LED.addInstance();

/**
 * Write custom configuration values to the imported modules.
 */
const CCFG              = scripting.addModule("/ti/devices/CCFG", {}, false);
CCFG.ccfgTemplate.$name = "ti_devices_CCFGTemplate0";

UART1.$name               = "CONFIG_UART_0";
UART1.$hardware           = system.deviceData.board.components.XDS110UART;
UART1.txPinInstance.$name = "CONFIG_PIN_1";
UART1.rxPinInstance.$name = "CONFIG_PIN_2";

Button1.$name                     = "BUTTON0";
Button1.$hardware                 = system.deviceData.board.components["BTN-1"];
Button1.gpioPin.$name             = "CONFIG_GPIO_0";
Button1.gpioPin.mode              = scripting.forceWrite("Input");
Button1.gpioPin.callbackFunction  = "buttonCallback";
Button1.gpioPin.pinInstance.$name = "CONFIG_PIN_3";

LED1.$hardware                               = system.deviceData.board.components.LED_RED;
LED1.dimmable                                = true;
LED1.$name                                   = "LED0";
LED1.pwmPin.timerObject.$name                = "CONFIG_GPTIMER_0";
LED1.pwmPin.timerObject.pwmPinInstance.$name = "CONFIG_PIN_0";

/**
 * Pinmux solution for unlocked pins/peripherals. This ensures that minor changes to the automatic solver in a future
 * version of the tool will not impact the pinmux you originally saw.  These lines can be completely deleted in order to
 * re-solve from scratch.
 */
UART1.uart.$suggestSolution                           = "UART1";
UART1.uart.txPin.$suggestSolution                     = "boosterpack.4";
UART1.uart.rxPin.$suggestSolution                     = "boosterpack.3";
Button1.gpioPin.gpioPin.$suggestSolution              = "boosterpack.13";
LED1.pwmPin.timerObject.timer.$suggestSolution        = "GPTM0";
LED1.pwmPin.timerObject.timer.pwmPin.$suggestSolution = "boosterpack.39";
